## boards/shields/hatsu64/Kconfig.defconfig
```kconfig
# SPDX-License-Identifier: MIT


if SHIELD_HATSU64_DONGLE_CENTRAL || SHIELD_HATSU64_LEFT_CENTRAL

# Max 16 characters in keyboard name
config ZMK_KEYBOARD_NAME
    default "Hatsu64"

config ZMK_SPLIT_ROLE_CENTRAL
    default y

# Set this to the number of peripherals your dongle will have.
# For a unibody, this would be 1. If you have left and right halves, set it to 2, etc.
config ZMK_SPLIT_BLE_CENTRAL_PERIPHERALS
    default 2

# Set this to ZMK_SPLIT_BLE_CENTRAL_PERIPHERALS + your desired number of BT profiles (default is 5)
config BT_MAX_CONN
    default 5

# Set this to the same number as BT_MAX_CONN
config BT_MAX_PAIRED
    default 5

endif # CENTRAL



if SHIELD_HATSU64_LEFT_CENTRAL || SHIELD_HATSU64_LEFT_PERIPHERAL || SHIELD_HATSU64_RIGHT_PERIPERAL || SHIELD_HATSU64_DONGLE_CENTRAL

config ZMK_SPLIT
    default y

endif # L, R, L_CENTRAL, DONGLE



if ZMK_DISPLAY

config I2C
    default y

config SSD1306
    default y

choice ZMK_DISPLAY_WORK_QUEUE
    default ZMK_DISPLAY_WORK_QUEUE_DEDICATED
endchoice

endif # ZMK_DISPLAY

if LVGL

config LV_Z_VDB_SIZE
    default 64

config LV_DPI_DEF
    default 148

config LV_Z_BITS_PER_PIXEL
    default 1

choice LV_COLOR_DEPTH
    default LV_COLOR_DEPTH_1
endchoice

endif # LVGL
```

## boards/shields/hatsu64/Kconfig.shield
```kconfig
# SPDX-License-Identifier: MIT

config SHIELD_HATSU64_LEFT_PERIPHERAL
    def_bool $(shields_list_contains,hatsu64_left_peripheral)

config SHIELD_HATSU64_LEFT_CENTRAL
    def_bool $(shields_list_contains,hatsu64_left_central)

config SHIELD_HATSU64_RIGHT_PERIPERAL
    def_bool $(shields_list_contains,hatsu64_right_periperal)

config SHIELD_HATSU64_DONGLE_CENTRAL
    def_bool $(shields_list_contains,hatsu64_dongle_central)
```
